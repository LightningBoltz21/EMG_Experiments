## Firmware/build/Firmware/Kconfig/boards/Kconfig
```kconfig
# Load Zephyr board Kconfig descriptions.
osource "/home/bhrz/ncs/v3.0.0/zephyr/boards/nordic/nrf5340dk/Kconfig"
```

## Firmware/build/Firmware/Kconfig/boards/Kconfig.nrf5340dk
```kconfig
# Load board Kconfig descriptions.
osource "/home/bhrz/ncs/v3.0.0/zephyr/boards/nordic/nrf5340dk/Kconfig.nrf5340dk"
```

## Firmware/build/Kconfig/arch/Kconfig
```kconfig
# Load Zephyr Arch Kconfig descriptions.
osource "/home/bhrz/ncs/v3.0.0/zephyr/arch/x86/Kconfig"
osource "/home/bhrz/ncs/v3.0.0/zephyr/arch/xtensa/Kconfig"
osource "/home/bhrz/ncs/v3.0.0/zephyr/arch/sparc/Kconfig"
osource "/home/bhrz/ncs/v3.0.0/zephyr/arch/riscv/Kconfig"
osource "/home/bhrz/ncs/v3.0.0/zephyr/arch/posix/Kconfig"
osource "/home/bhrz/ncs/v3.0.0/zephyr/arch/nios2/Kconfig"
osource "/home/bhrz/ncs/v3.0.0/zephyr/arch/mips/Kconfig"
osource "/home/bhrz/ncs/v3.0.0/zephyr/arch/arm64/Kconfig"
osource "/home/bhrz/ncs/v3.0.0/zephyr/arch/arm/Kconfig"
osource "/home/bhrz/ncs/v3.0.0/zephyr/arch/arc/Kconfig"
```

## Firmware/build/Kconfig/boards/Kconfig.defconfig
```kconfig
# Load Zephyr board defconfig descriptions.
osource "/home/bhrz/ncs/v3.0.0/zephyr/boards/nordic/nrf5340dk/Kconfig.defconfig"
```
